## conf/distro/include/rbz-imx-base.inc
```bitbake
MAINTAINER = "RBZ <info@rbz.es>"

PREFERRED_PROVIDER_virtual/bootloader:imx-nxp-bsp = "u-boot-imx-rbz"
PREFERRED_PROVIDER_u-boot:imx-nxp-bsp = "u-boot-imx-rbz"
PREFERRED_PROVIDER_u-boot-mfgtool:imx-nxp-bsp = "u-boot-imx-rbz"
PREFERRED_RPROVIDER_u-boot-default-env:imx-nxp-bsp = "u-boot-imx-rbz"
PREFERRED_PROVIDER_virtual/kernel:imx-nxp-bsp = "linux-imx-rbz"
PREFERRED_PROVIDER_linux-mfgtool:imx-nxp-bsp = "linux-imx-rbz"
```

## conf/distro/mod-rbz-xwayland.conf
```bitbake
# RBZ DISTRO for Wayland with X11

require conf/distro/include/fsl-imx-base.inc
require conf/distro/include/fsl-imx-extended.inc
require conf/distro/include/rbz-imx-base.inc

DISTRO = "mod-rbz-xwayland"
DISTRO_NAME = "RBZ i.MX Distro with Wayland and XWayland"

DISTRO_FEATURES:append = " x11 wayland pam"

PACKAGECONFIG:append:pn-weston      = " rdp"
PACKAGECONFIG:append:pn-weston-init = " rdp"
```

## conf/machine/include/rbz-mod-imx8m.inc
```bitbake
require conf/machine/include/imx-base.inc
require conf/machine/include/arm/armv8a/tune-cortexa53.inc

MACHINE_FEATURES:append:use-nxp-bsp = " optee"

IMX_DEFAULT_BSP = "nxp"
IMX_DEFAULT_BOOTLOADER:imx-nxp-bsp = "u-boot-imx-rbz"
IMX_DEFAULT_KERNEL:imx-nxp-bsp = "linux-imx-rbz"

# imx-base.inc enables the U-Boot binman container when the bootloader is not
# "u-boot-imx"; RBZ still uses imx-boot (imx-mkimage)
UBOOT_PROVIDES_BOOT_CONTAINER:mx8m-generic-bsp = "0"

UBOOT_SUFFIX = "bin"
UBOOT_CONFIG ??= "sd"
SPL_BINARY = "spl/u-boot-spl.bin"

IMXBOOT_TARGETS_BASENAME = "flash_evk"
IMXBOOT_TARGETS = \
    "${@bb.utils.contains('UBOOT_CONFIG', 'fspi', '${IMXBOOT_TARGETS_BASENAME}_flexspi', \
                                                  '${IMXBOOT_TARGETS_BASENAME}', d)}"
IMXBOOT_TARGETS += "${IMXBOOT_TARGETS_BASENAME}_flexspi"

SERIAL_CONSOLES = "115200;ttymxc2"
ATF_BOOT_UART_BASE = "0x30880000"

LOADADDR = ""
UBOOT_MAKE_TARGET = "all"

IMAGE_BOOT_FILES:append = " boot.scr"
WKS_FILE_DEPENDS:append = " u-boot-script-rbz"

MACHINE_FIRMWARE:append = " linux-firmware-ath10k"
```

## conf/machine/mod_imx8m_mini.conf
```bitbake
#@TYPE: Machine
#@NAME: RBZ MOD_IMX8M_MINI Board
#@SOC: i.MX8MM
#@DESCRIPTION: Machine configuration for RBZ MOD_IMX8M_MINI BOARD
#@MAINTAINER: Carlos Amor <camor@rbz.es>

MACHINEOVERRIDES =. "mx8mm:"

require conf/machine/include/rbz-mod-imx8m.inc

KERNEL_DEVICETREE_BASENAME = "mod-imx8m-mini"
KERNEL_DEVICETREE = " \
    rbz/rbz-carrier-basic-imx8m-mini-lvds.dtb \
    rbz/rbz-carrier-basic-imx8m-mini-hdmi.dtb \
"

UBOOT_DTB_NAME = "mod-imx8m-mini.dtb"

UBOOT_CONFIG_BASENAME = "mod_imx8m_mini"
UBOOT_CONFIG[fspi] = "${UBOOT_CONFIG_BASENAME}_fspi_defconfig"
UBOOT_CONFIG[sd]   = "${UBOOT_CONFIG_BASENAME}_defconfig"

ATF_PLATFORM = "imx8mm"
ATF_LOAD_ADDR = "0x920000"

IMX_BOOT_SOC_TARGET = "iMX8MM"
IMX_BOOT_SEEK = "33"

DDR_FIRMWARE_NAME = " \
    lpddr4_pmu_train_1d_imem.bin \
    lpddr4_pmu_train_1d_dmem.bin \
    lpddr4_pmu_train_2d_imem.bin \
    lpddr4_pmu_train_2d_dmem.bin \
"

OPTEE_BIN_EXT = "8mm"
# FIXME: with CFG_DDR_SIZE=1GB OP-TEE links at 0x7e000000, not 0xbe000000
TEE_LOAD_ADDR = "0xbe000000"
EXTRA_OEMAKE:append:pn-optee-os = " CFG_DDR_SIZE=0x40000000 CFG_UART_BASE=UART3_BASE"
```

## conf/machine/mod_imx8m_nano.conf
```bitbake
#@TYPE: Machine
#@NAME: RBZ MOD_IMX8M_NANO Board
#@SOC: i.MX8MN
#@DESCRIPTION: Machine configuration for RBZ MOD_IMX8M_NANO BOARD
#@MAINTAINER: Carlos Amor <camor@rbz.es>

MACHINEOVERRIDES =. "mx8mn:"

require conf/machine/include/rbz-mod-imx8m.inc

KERNEL_DEVICETREE_BASENAME = "mod-imx8m-nano"
KERNEL_DEVICETREE = " \
    rbz/rbz-carrier-basic-imx8m-nano.dtb \
"

UBOOT_DTB_NAME = "mod-imx8m-nano.dtb"

UBOOT_CONFIG_BASENAME = "mod_imx8m_nano"
UBOOT_CONFIG[fspi] = "${UBOOT_CONFIG_BASENAME}_defconfig"
UBOOT_CONFIG[sd]   = "${UBOOT_CONFIG_BASENAME}_defconfig"

ATF_PLATFORM = "imx8mn"
ATF_LOAD_ADDR = "0x960000"

IMX_BOOT_SOC_TARGET = "iMX8MN"
IMX_BOOT_SEEK = "32"

DDR_FIRMWARE_NAME = " \
    lpddr4_pmu_train_1d_dmem.bin \
    lpddr4_pmu_train_1d_imem.bin \
    lpddr4_pmu_train_2d_dmem.bin \
    lpddr4_pmu_train_2d_imem.bin \
"

OPTEE_BIN_EXT = "8mn"
TEE_LOAD_ADDR = "0x56000000"
EXTRA_OEMAKE:append:pn-optee-os = " CFG_DDR_SIZE=0x40000000 CFG_UART_BASE=UART3_BASE"
```

## conf/machine/mod_imx8m_plus.conf
```bitbake
#@TYPE: Machine
#@NAME: RBZ MOD_IMX8M_PLUS Board
#@SOC: i.MX8MP
#@DESCRIPTION: Machine configuration for RBZ MOD_IMX8M_PLUS BOARD
#@MAINTAINER: Carlos Amor <camor@rbz.es>

MACHINEOVERRIDES =. "mx8mp:"

require conf/machine/include/rbz-mod-imx8m.inc

KERNEL_DEVICETREE_BASENAME = "mod-imx8m-plus"
KERNEL_DEVICETREE = " \
    rbz/rbz-carrier-basic-imx8m-plus.dtb \
"

UBOOT_DTB_NAME = "mod-imx8m-plus.dtb"

UBOOT_CONFIG_BASENAME = "mod_imx8m_plus"
UBOOT_CONFIG[fspi] = "${UBOOT_CONFIG_BASENAME}_defconfig"
UBOOT_CONFIG[sd]   = "${UBOOT_CONFIG_BASENAME}_defconfig"

ATF_PLATFORM = "imx8mp"
ATF_LOAD_ADDR = "0x970000"

IMX_BOOT_SOC_TARGET = "iMX8MP"
IMX_BOOT_SEEK = "32"

DDR_FIRMWARE_VERSION = "202006"
DDR_FIRMWARE_NAME = " \
    lpddr4_pmu_train_1d_dmem_${DDR_FIRMWARE_VERSION}.bin \
    lpddr4_pmu_train_1d_imem_${DDR_FIRMWARE_VERSION}.bin \
    lpddr4_pmu_train_2d_dmem_${DDR_FIRMWARE_VERSION}.bin \
    lpddr4_pmu_train_2d_imem_${DDR_FIRMWARE_VERSION}.bin \
"

OPTEE_BIN_EXT = "8mp"
TEE_LOAD_ADDR = "0x56000000"
EXTRA_OEMAKE:append:pn-optee-os = " CFG_UART_BASE=UART3_BASE"
```
